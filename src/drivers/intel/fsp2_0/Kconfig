## src/drivers/intel/fsp2_0/Kconfig
```kconfig
config PLATFORM_USES_FSP2_0
	bool
	help
	  Include FSP 2.0 wrappers and functionality

if PLATFORM_USES_FSP2_0

comment "Intel FSP 2.0"

config ADD_FSP_BINARIES
	bool "Add Intel FSP 2.0 binaries to CBFS"
	help
	  Add the FSP-M and FSP-S binaries to CBFS. Note that coreboot does not
	  use the FSP-T binary, so that will not be included.

config FSP_M_FILE
	string "Intel FSP-M (memory init) binary path and filename"
	depends on ADD_FSP_BINARIES
	help
	  The path and filename of the Intel FSP-M binary for this platform.

config FSP_S_FILE
	string "Intel FSP-S (silicon init) binary path and filename"
	depends on ADD_FSP_BINARIES
	help
	  The path and filename of the Intel FSP-S binary for this platform.


config ADD_VBT_DATA_FILE
	bool "Add a Video Bios Table (VBT) binary to CBFS"
	help
	  Add a VBT file data file to CBFS. The VBT describes the integrated
	  GPU and connections, and is needed by FSP in order to initialize the
	  display.

config VBT_FILE
	string "VBT binary path and filename"
	depends on ADD_VBT_DATA_FILE
	help
	  The path and filename of the VBT binary for this platform.

config FIT_CAR_ADDR
	hex
	default 0xfef2dc00

# Cache As RAM region layout:
#
# +-------------+ DCACHE_RAM_BASE + DCACHE_RAM_SIZE    [0xff000000]
# |   Unused    |
# +-------------+ ---------------------------------    [0xfefa0000]
# |             |
# |   FSP-M     |
# |   code      |
# |             |
# +-------------+ FSP-M                                [0xfef50000]
# |  romstage   |
# |    code     |
# +-------------+ ROMSTAGE_CAR_ADDR                    [0xfef2e000]
# |  FIT TABLE  |
# +-------------+ FIT_CAR_ADDR                         [0xfef2dc00]
# |   FSP-M     |
# | stack/data  |
# +-------------+ DCACHE_RAM_BASE + 0x4000             [0xfef04000]
# |  Stack      |
# |    |        |
# |    v        |
# +-------------+
# |    ^        |
# |    |        |
# | CAR Globals |
# +-------------+ DCACHE_RAM_BASE                      [0xfef00000]


endif # PLATFORM_USES_FSP2_0
```

## src/mainboard/intel/apollolake_rvp/Kconfig
```kconfig
if BOARD_INTEL_APOLLOLAKE_RVP1 || BOARD_INTEL_APOLLOLAKE_RVP2

config BOARD_SPECIFIC_OPTIONS
	def_bool y
	select SOC_INTEL_APOLLOLAKE
	select BOARD_ROMSIZE_KB_8192
	select HAVE_ACPI_TABLES

config MAINBOARD_DIR
	string
	default intel/apollolake_rvp

config MAINBOARD_PART_NUMBER
	string
	default "Apollolake RVP"

config MAINBOARD_VENDOR
	string
	default "Intel"

config FMAP_FILE
	string
	default aplk.rvp

config PREBUILT_SPI_IMAGE
	string
	default aplk.rvp1.bin.orig if BOARD_INTEL_APOLLOLAKE_RVP1
	default aplk.rvp2.bin.orig if BOARD_INTEL_APOLLOLAKE_RVP2

config IFD_BIOS_END
	hex
	default 0x6FF000

config IFD_BIOS_START
	hex
	default 0x1000

config FLASHMAP_OFFSET
	hex
	default 0xc4480

endif # BOARD_INTEL_APOLLOLAKE_RVP1 || BOARD_INTEL_APOLLOLAKE_RVP2
```

## src/soc/intel/apollolake/Kconfig
```kconfig
config SOC_INTEL_APOLLOLAKE
	bool
	help
	  Intel Apollolake support

if SOC_INTEL_APOLLOLAKE

config CPU_SPECIFIC_OPTIONS
	def_bool y
	select ARCH_BOOTBLOCK_X86_32
	select ARCH_RAMSTAGE_X86_32
	select ARCH_ROMSTAGE_X86_32
	select ARCH_VERSTAGE_X86_32
	# CPU specific options
	select CPU_INTEL_FIRMWARE_INTERFACE_TABLE
	select IOAPIC
	select SMP
	select SSE2
	select SUPPORT_CPU_UCODE_IN_CBFS
	# Misc options
	select C_ENVIRONMENT_BOOTBLOCK
	select COLLECT_TIMESTAMPS
	select DRIVERS_UART_8250MEM_32
	select HAVE_INTEL_FIRMWARE
	select MMCONF_SUPPORT
	select MMCONF_SUPPORT_DEFAULT
	select PARALLEL_MP
	select PCIEXP_ASPM
	select PCIEXP_COMMON_CLOCK
	select PCIEXP_CLK_PM
	select PCIEXP_L1_SUB_STATE
	select REG_SCRIPT
	select UDELAY_TSC
	select TSC_CONSTANT_RATE
	select PLATFORM_USES_FSP2_0

config X86_TOP4G_BOOTMEDIA_MAP
	bool
	default n

config MMCONF_BASE_ADDRESS
	hex "PCI MMIO Base Address"
	default 0xe0000000

config IOSF_BASE_ADDRESS
	hex "MMIO Base Address of sideband bus"
	default 0xd0000000

config CONSOLE_UART_BASE_ADDRESS
	depends on CONSOLE_SERIAL
	hex "MMIO base address for UART"
	default 0xde000000

config DCACHE_RAM_BASE
	hex "Base address of cache-as-RAM"
	default 0xfef00000

config DCACHE_RAM_SIZE
	hex "Length in bytes of cache-as-RAM"
	default 0x80000
	help
	  The size of the cache-as-ram region required during bootblock
	  and/or romstage.

config DCACHE_RAM_BOOTBLOCK_STACK_SIZE
	hex
	default 0x800
	help
	  The amount of anticipated stack usage from the bootblock during
	  pre-romstage initialization.

config IFD_BIOS_START
	hex
	default 0x1000
	help
	  The starting address of flash region 1 (BIOS), as declared in the
	  firmware descriptor. This can be obtained via 'ifdtool -d'.

config IFD_BIOS_END
	hex
	default ROM_SIZE
	help
	  The ending address of flash region 1 (BIOS), as declared in the
	  firmware descriptor. This can be obtained via 'ifdtool -d'.

config CPU_ADDR_BITS
	int
	default 36

endif
```
